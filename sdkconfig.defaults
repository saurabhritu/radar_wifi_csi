## sdkconfig.defaults
```kconfig
# Fix for 431 Request Header Fields Too Large
CONFIG_HTTPD_MAX_REQ_HDR_LEN=4096
CONFIG_HTTPD_WS_SUPPORT=y

# Buffer sizes for radar engine
CONFIG_FREERTOS_TIMER_TASK_STACK_DEPTH=4096
CONFIG_ESP_TIMER_TASK_STACK_SIZE=5120

# Networking Limits - Increased for WebSocket stability
CONFIG_LWIP_MAX_SOCKETS=16
```
